/**************************************************
 * 文件名:    test_display_refresh.c
 * 作者:      GitHub Copilot
 * 日期:      2025-10-08
 * 描述:      测试数码管高速刷新效果
 *           验证1秒内连续刷新是否无闪烁
 **************************************************/

#include <reg52.h>
#include "display.h"
#include "timer.h"

// 倒计时变量（由Timer0更新）
unsigned char countdown = 9;

/**
 * @brief  Timer0中断服务函数 - 1秒定时
 */
void Timer0_ISR(void) interrupt 1
{
    static unsigned char count = 0;
    
    TH0 = (65536 - 50000) / 256;  // 重装载
    TL0 = (65536 - 50000) % 256;
    
    count++;
    if (count >= 20)  // 20次 × 50ms = 1秒
    {
        count = 0;
        
        // 更新倒计时
        if (countdown > 0)
            countdown--;
        else
            countdown = 9;  // 循环
    }
}

/**
 * @brief  Timer0初始化：1秒定时
 */
void Timer0_Init(void)
{
    TMOD = 0x01;  // Timer0模式1（16位定时器）
    TH0 = (65536 - 50000) / 256;
    TL0 = (65536 - 50000) % 256;
    TR0 = 1;      // 启动Timer0
    ET0 = 1;      // 使能Timer0中断
}

/**
 * @brief  主函数
 */
void main(void)
{
    unsigned char nsTime, ewTime;
    
    // 初始化
    Display_Init();
    Timer0_Init();
    
    EA = 1;  // 开启总中断
    
    // 测试说明：通过Delay_s延时查看效果
    // 方式1：使用阻塞式刷新（推荐）
    Delay_s(2);  // 等待2秒
    
    while(1)
    {
        // ============ 测试1：固定显示 ============
        // 显示 "88"，验证是否稳定、无闪烁
        Display_ShowTime_1s(8, 8);
        Display_ShowTime_1s(8, 8);
        Display_ShowTime_1s(8, 8);
        
        // ============ 测试2：倒计时显示 ============
        // 读取当前倒计时
        EA = 0;
        nsTime = countdown;
        ewTime = (countdown > 0) ? (countdown - 1) : 9;
        EA = 1;
        
        // 持续显示1秒（与Timer0同步）
        Display_ShowTime_1s(nsTime, ewTime);
    }
}

/*
 * ============================================================
 *                      测试说明
 * ============================================================
 * 
 * 【测试1：固定显示 "88"】
 * - 持续显示3秒（3次 × 1秒）
 * - 观察数码管是否稳定、无闪烁
 * - 两个数码管应该同时亮起，看不出切换过程
 * 
 * 【测试2：倒计时显示】
 * - 左边数码管：9 → 8 → 7 → ... → 0 → 9 (循环)
 * - 右边数码管：8 → 7 → 6 → ... → 9 → 8 (比左边小1)
 * - 每个数字持续1秒，中途不闪烁
 * 
 * 【预期结果】
 * ✅ 数码管显示稳定，无闪烁
 * ✅ 两个数码管同时显示，看不出切换
 * ✅ 每秒数字准确变化一次
 * 
 * 【如果出现闪烁】
 * 1. 检查 Display_ShowTime_1s() 中的刷新次数（当前200次）
 * 2. 增加刷新次数到300或400
 * 3. 检查每次刷新的延时时间（当前30×10循环）
 * 
 * 【性能说明】
 * - 单次刷新：约5ms（两个数码管各2ms）
 * - 1秒刷新次数：200次
 * - 刷新频率：200Hz（远超人眼50Hz临界值）
 * - CPU占用：较高（因为主循环一直在刷新）
 * 
 * ============================================================
 */
